## main/Kconfig.projbuild
```kconfig
menu "Example Configuration"

    config ASSISTANT_REPLY_SCROLL_CPS
        int "Answer scrolling speed (characters per second)"
        default 16
        range 5 60
        help
            The answer scrolls on screen following the speech, read at this many characters per second.
            Overridden by the "Scroll_speed" key of CONFIG.INI.

    config ASSISTANT_LANGUAGE
        string "Default assistant language"
        default "fr"
        help
            ISO-639-1 code (fr, en, ...) used for speech transcription, the assistant's
            answers and the on-screen texts. Overridden by the "Language" key of the
            device configuration (CONFIG.INI) when present.

    config ASSISTANT_LANGUAGES
        string "Languages offered (code:name, comma-separated)"
        default "FR:Français, EN:English"
        help
            The languages of the Settings screen and of "change la langue". Each one has its files on the
            configuration drive (LANG_<CODE>.TXT, VOICE_<CODE>.TXT, PERSO_<CODE>.TXT), made from the English
            ones when a language is added. Default of Languages in CONFIG.INI, which takes precedence.

    config ASSISTANT_CHAT_MODEL
        string "Default chat model"
        default "claude-haiku-5-5"
        help
            Model answering the questions: a Claude model id (claude-...) or an OpenAI one (gpt-...).
            Overridden by the "Chat_model" key of CONFIG.INI, which the Settings screen also sets.

    config ASSISTANT_STT_MODEL
        string "Speech-to-text model"
        default "gpt-live-transcribe"
        help
            Transcription model, one of the [stt] section of AGENTS.INI (OpenAI gpt-live-transcribe, Mistral
            voxtral-mini-transcribe-realtime-3-0). Default of Stt_model in CONFIG.INI, which takes precedence
            ("change de transcription" sets it).

    config ASSISTANT_END_OF_SPEECH_MS
        int "End of speech silence (ms)"
        default 900
        range 300 3000
        help
            Silence after which the question is considered finished. Lower answers faster but may
            cut the user during a pause. Default of End_speech_ms in CONFIG.INI, which takes precedence.

    config ASSISTANT_TTS_MODEL
        string "Speech synthesis model"
        default "gpt-realtime-2.1-mini"
        help
            Speech model reading the answer aloud, one of the [tts] section of AGENTS.INI (OpenAI
            gpt-realtime-2.1-mini, Mistral voxtral-mini-tts-3-0). Default of Tts_model in CONFIG.INI, which takes
            precedence ("change de synthèse vocale" sets it).

    config ASSISTANT_OPENAI_URL
        string "OpenAI base URL"
        default "https://api.openai.com/v1/"
        help
            Written to the "Base_url" key of CONFIG.INI when it does not exist yet.

    config ASSISTANT_SHOW_CLOCK
        string "Clock shown while the assistant sleeps (on or off)"
        default "on"
        help
            Time and date on the sleep screen. Default of Show_clock in CONFIG.INI, which takes precedence
            (also changed by voice: "affiche l'heure", "cache l'heure").

    config ASSISTANT_SLEEP_AFTER_CMD
        string "Sleep after a voice command handled by the device (on or off)"
        default "off"
        help
            on: after the reply to a voice command handled by the device itself (settings, memory...), the
            assistant goes back to sleep instead of listening again; a command asking a question still listens
            for the answer. Default of Sleep_after_cmd in CONFIG.INI, which takes precedence.

    config ASSISTANT_CURRENCY
        string "Currency of the prices of AGENTS.INI and of the costs (EUR, USD...)"
        default "EUR"
        help
            The prices of AGENTS.INI are given in this currency (no conversion); the costs (COSTS.TXT, screen)
            are shown in it. Default of Currency in CONFIG.INI, which takes precedence.

    config ASSISTANT_RADIO_RESUME
        string "Radio: resumed after a conversation (on or off)"
        default "on"
        help
            on: a radio interrupted by the wake word plays again when the assistant goes back to sleep; off: it
            stays stopped ("remets la radio" plays it again). A station asked during the conversation plays
            anyway. Default of Radio_resume in CONFIG.INI, which takes precedence.

    config ASSISTANT_READ_LISTS
        string "Lists of the voice commands read aloud (on or off)"
        default "off"
        help
            off: in the replies listing languages, providers, models or voices, the reading stops at the "::"
            of the LANG text (shown as ":"), the list is only shown; on: the list is read too. Default of
            Read_lists in CONFIG.INI, which takes precedence.

    config ASSISTANT_RADIO_LEVEL
        int "Radio: level the stations are brought to (dBFS)"
        default -16
        range -30 -6
        help
            Mean level every station is brought to (the gain goes from -12 to +6 dB), in dBFS: higher is louder.
            Default of Radio_level in CONFIG.INI, which takes precedence.

    config ASSISTANT_RADIO_TREBLE
        int "Radio: treble, in dB (negative: softer)"
        default -6
        range -12 6
        help
            Gain of the treble (above about 3 kHz) of the radio, in dB: negative softens them on the small
            speaker, 0 leaves the sound as it is. Default of Radio_treble in CONFIG.INI, which takes precedence.

    config ASSISTANT_SCREEN_OFF_S
        int "Screen off without presence (s)"
        default 10
        range 0 3600
        help
            With the BOX-3-SENSOR dock: seconds without presence before the screen goes off while the
            assistant sleeps (0: never). Default of Screen_off_s in CONFIG.INI, which takes precedence.

    config ASSISTANT_OPENROUTER_FREE
        string "Free OpenRouter models read from its live list (on or off)"
        default "on"
        help
            Default of OpenRouter_free in CONFIG.INI, which takes precedence.

    config ASSISTANT_FREE_MODELS
        int "Free OpenRouter models offered"
        default 6
        range 1 15
        help
            The most recent free models of OpenRouter's live list offered, besides "openrouter/free".
            Default of Free_models in CONFIG.INI, which takes precedence.

    config ASSISTANT_CONFIRM_OFF
        string "Homey device classes confirmed before being turned off"
        default "socket"
        help
            Comma-separated Homey device classes (socket: power plugs) that the assistant asks to confirm
            before turning them off; "off" for none. Default of Confirm_off in CONFIG.INI, which takes
            precedence.

    config ASSISTANT_SCROLL_MODE
        string "Answer scrolling mode (line or smooth)"
        default "line"
        help
            "line" moves one whole line at a time, "smooth" scrolls continuously. Default of Scroll_mode in
            CONFIG.INI, which takes precedence.

    config ASSISTANT_TTS_VOICE
        string "Speech synthesis voice"
        default "marin"
        help
            OpenAI voice, e.g. marin, cedar, coral, nova.

    config ASSISTANT_MISTRAL_VOICE
        string "Speech synthesis voice of Mistral"
        default "fr_marie_neutral"
        help
            Voice of Voxtral TTS (Mistral), e.g. fr_marie_neutral, gb_jane_neutral. Default of Mistral_voice in
            CONFIG.INI, which takes precedence ("change de voix" sets it while a Mistral speech model is used).

    config ASSISTANT_TIMEZONE
        string "Time zone (POSIX TZ)"
        default "CET-1CEST,M3.5.0,M10.5.0/3"
        help
            Time zone of the clock shown while the robot sleeps (time from pool.ntp.org).
            Default: Central European Time with summer time (Brussels, Paris).

    config ASSISTANT_FOLLOWUP_WINDOW_MS
        int "Follow-up listening window (ms)"
        default 4000
        range 0 30000
        help
            After a spoken reply, keep listening this long without wake word so that the
            conversation can continue. If nobody speaks, the device goes back to sleep.
            0 disables follow-up listening.

    config VOLUME_LEVEL
        int "volume level"
        default "90"
        range 1 100
        help
            Speaker volume. Default of Volume in CONFIG.INI, which takes precedence.
    config ESP_MAXIMUM_RETRY
        int "Maximum retry"
        default 5
        help
            Set the Maximum retry to avoid station reconnecting to the AP unlimited when the AP is really inexistent.

    choice ESP_WIFI_SCAN_AUTH_MODE_THRESHOLD
        prompt "WiFi Scan auth mode threshold"
        default ESP_WIFI_AUTH_WPA2_PSK
        help
            The weakest authmode to accept in the scan mode.

        config ESP_WIFI_AUTH_OPEN
            bool "OPEN"
        config ESP_WIFI_AUTH_WEP
            bool "WEP"
        config ESP_WIFI_AUTH_WPA_PSK
            bool "WPA PSK"
        config ESP_WIFI_AUTH_WPA2_PSK
            bool "WPA2 PSK"
        config ESP_WIFI_AUTH_WPA_WPA2_PSK
            bool "WPA/WPA2 PSK"
        config ESP_WIFI_AUTH_WPA3_PSK
            bool "WPA3 PSK"
        config ESP_WIFI_AUTH_WPA2_WPA3_PSK
            bool "WPA2/WPA3 PSK"
        config ESP_WIFI_AUTH_WAPI_PSK
            bool "WAPI PSK"
    endchoice

endmenu
# The configuration mode (factory_nvs/) writes these defaults to CONFIG.INI: its CMakeLists.txt reads the
# CONFIG_ASSISTANT_* and CONFIG_VOLUME_LEVEL values of this project's sdkconfig (rebuild it after a change).
```
